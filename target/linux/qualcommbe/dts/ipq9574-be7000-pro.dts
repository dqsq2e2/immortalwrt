// SPDX-License-Identifier: (GPL-2.0+ OR BSD-3-Clause)

#include "ipq9554-be7000.dts"

/ {
	model = "Xiaomi BE7000 Pro";
	compatible = "xiaomi,be7000-pro", "qcom,ipq9574";
};

&wifi0 {
	qcom,calibration-variant = "Xiaomi-BE7000-Pro";
};

&wifi1 {
	qcom,calibration-variant = "Xiaomi-BE7000-Pro";
};
